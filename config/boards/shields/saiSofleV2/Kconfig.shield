## config/boards/shields/saiSofleV2/Kconfig.shield
```kconfig
config SHIELD_SAISOFLEV2_LEFT
    def_bool $(shields_list_contains, saiSofleV2_left)

config SHIELD_SAISOFLEV2_RIGHT
    def_bool $(shields_list_contains, saiSofleV2_right)
```

## config/west.yml
```yaml
manifest:
  remotes:
    - name: zmkfirmware
      url-base: https://github.com/zmkfirmware
    - name: urob
      url-base: https://github.com/urob
    - name: saitamandl
      url-base: https://github.com/saitamandl
  projects:
    - name: zmk
      remote: urob
      revision: main
      import: app/west.yml
    - name: zmk-helpers
      remote: saitamandl
      revision: v2
  self:
    path: config
```
