/*
 * Copyright (c) 2023 The ZMK Contributors
 *
 * SPDX-License-Identifier: MIT
 */

#include <behaviors.dtsi>
#include <dt-bindings/zmk/bt.h>
#include <dt-bindings/zmk/rgb.h>
#include <dt-bindings/zmk/keys.h>
#include <dt-bindings/zmk/ext_power.h>

#include "mouse.dtsi"
#include "zmk-helpers/helper.h"
#include "zmk-helpers/unicode-chars/german.dtsi"
#include "zmk-helpers/unicode-chars/currency.dtsi"

/** Global settings */
/** Constants */
#define QUICK_TAP_MS                175
#define TAPPING_TERM_MS             200
#define TAP_DANCE_TAPPING_TERM_MS   300
#define MT_CORE_TAPPING_TERM_MS     220
#define MT_CORE_QUICK_TAP_MS        220
#define HRM_QUICK_TAP_MS            125
#define HRM_TAPPING_TERM_MS         280
#define HRM_REQUIRE_PRIOR_IDLE_MS   150
#define WAIT_MS                     100
#define TAP_MS                      5
#define RELEASE_AFTER_MS            900

/** RGB */
#define UNDER_GLOW_PER_KEY_LED_COUNT    35
#define PER_KEY_LED_COUNT               29

/** trans/none */
#define _____       &trans
#define XXXXX       &none

/** Navigations */
#define NAV_LEFT    &mt_home 0   LEFT    // tap: left  | long-tap: beginning of line
#define NAV_RIGHT   &mt_end 0    RIGHT   // tap: right | long-tap: end       of line
#define NAV_UP      &mt LC(HOME) UP      // tap: up    | long-tap: beginning of document
#define NAV_DOWN    &mt LC(END)  DOWN    // tap: down  | long-tap: end       of document
#define NAV_BSPC    &mt LC(BSPC) BSPC    // tap: bspc  | long-tap: delete word backward
#define NAV_DEL     &mt LC(DEL)  DEL     // tap: del   | long-tap: delete word forward

/** VoLume */
#define VOL_U       &kp C_VOL_UP
#define VOL_D       &kp C_VOL_DN
#define VOL_MU      &kp C_MUTE
/** tap: Play/Pause | long-tap: Stop */
//#define VOL_DN_MU   &tap_preferred C_MUTE C_VOL_DN

/** Media */
//#define PP          &kp C_PP
//#define STOP        &kp C_STOP
//#define PREV        &kp C_PREV
//#define NEXT        &kp C_NEXT
#define REPEAT      &kp C_REPEAT
#define SHUFFLE     &kp C_SHUFFLE
//#define FF          &kp C_FF
//#define RW          &kp C_RW
#define SLOW        &kp C_SLOW

/** tap: Play/Pause | long-tap: Stop */
#define PP_S        &tap_preferred C_STOP C_PP
/** tap: Next | long-tap: Fast Forward */
#define NXT_FF      &tap_preferred C_FF C_NEXT
/** tap: Next | long-tap: Fast Forward */
#define PREV_RW     &tap_preferred C_RW C_PREV

/** Game layer */
#define Y_V             &hold_preferred     V       Y
#define G_H_B           &g_h_               B       0
#define N1_2_4          &n1_2_              N4      0
//#define F_SPC           &hold_preferred     SPACE   F
#define R_T             &hold_preferred     T       R
#define N2_4            &hold_preferred     N4      N2
#define M_ESC_CTRL      &m_esc_             LCTRL   0

/** RGB behaviors */
#define LED_TOG     &rgb_ug RGB_TOG
#define BRI_INC     &rgb_ug RGB_BRI     // Brightness increase
#define BRI_DEC     &rgb_ug RGB_BRD     // Brightness decrease
#define HUE_INC     &rgb_ug RGB_HUI
#define HUE_DEC     &rgb_ug RGB_HUD
#define SAT_INC     &rgb_ug RGB_SAI     // Saturation Increase
#define SAT_DEC     &rgb_ug RGB_SAD     // Saturation Decrease
#define SP_INC      &rgb_ug RGB_SPI     // Speed Increase
#define SP_DEC      &rgb_ug RGB_SPD     // Speed Decrease
#define EFF_FW      &rgb_ug RGB_EFF     // Effect forward
#define EFF_BCK     &rgb_ug RGB_EFR     // Effect reverse

#define PURPLE &rgb_ug RGB_COLOR_HSB(271, 79, 68)     // Specific Color

/** MISC */
#define EXT_POWER_TOG &ext_power EP_TOG       // toggle the external power
#define CANCEL        &kp K_CANCEL            // cancel caps-word, num-word

/**
 * Key Positions
 */
/** Left Split */
#define KEYS_L LN0 LN1 LN2 LN3 LN4 LN5 LT0 LT1 LT2 LT3 LT4 LT5 LM0 LM1 LM2 LM3 LM4 LM5 LB0 LB1 LB2 LB3 LB4 LB5
/** Right Split */
#define KEYS_R RN0 RN1 RN2 RN3 RN4 RN5 RT0 RT1 RT2 RT3 RT4 RT5 RM0 RM1 RM2 RM3 RM4 RM5 RB0 RB1 RB2 RB3 RB4 RB5
/** Thumbs */
#define THUMBS LH0 LH1 LH2 LH3 LH4 RH0 RH1 RH2 RH3 RH4

/** Layer Names */
#define DEF         0
#define NUMS     1
#define FNG      2
#define NAV         3
#define MOUSE       4
#define SYS         5
#define GAME        6

/** LED strip length for RGB */
&led_strip {
    chain-length = <PER_KEY_LED_COUNT>;
};

/** sticky-key config */
&sk {
    release-after-ms = <RELEASE_AFTER_MS>;  // release after 0.6s
    quick-release;                          // no double capitalization when rolling keys
};

/** sticky-layer config */
&sl {
    ignore-modifiers;          // allow chording sticky mods & layers
};

/** layer-tap config */
&lt {
    flavor = "balanced";
    tapping-term-ms = <TAPPING_TERM_MS>;
    quick-tap-ms = <QUICK_TAP_MS>;
};

/** mods deactivate caps-word, requires PR #1451 */
&caps_word {
    /delete-property/ ignore-modifiers;
    continue-list = <UNDERSCORE BACKSPACE DELETE LSHFT RSHFT>;
};

/** num-word, requires PR #1451 */
&num_word {
    layers = <NUMS>;
    continue-list = <BSPC DEL ESC LSHFT LCTRL LALT LGUI TAB RSHFT RCTRL RALT RGUI EXCL AT HASH DOLLAR PERCENT CARET AMPS STAR LPAR RPAR EQUAL PLUS MINUS UNDER FSLH QMARK BSLH PIPE SEMI COLON SQT DQT COMMA LT DOT GT LBKT LBRC RBKT RBRC GRAVE TILDE>;
};


/**-------------------------------- Custom Behaviors --------------------------------*/

/**
 * Functions
 */
/** reuse basic mod-morph scheme */
#define SIMPLE_MORPH(NAME, MOD, BINDING1, BINDING2) \
    ZMK_MOD_MORPH(NAME, \
        mods = <(MOD_L ## MOD|MOD_R ## MOD)>; \
        bindings = <BINDING1>, <BINDING2>; \
    )

/** Home row modifiers */
#define MAKE_HRM(NAME, HOLD, TAP, TRIGGER_POS) \
    ZMK_HOLD_TAP(NAME, \
        flavor = "balanced"; \
        tapping-term-ms = <HRM_TAPPING_TERM_MS>; \
        quick-tap-ms = <QUICK_TAP_MS>; \
        require-prior-idle-ms = <HRM_REQUIRE_PRIOR_IDLE_MS>; \
        bindings = <HOLD>, <TAP>; \
        hold-trigger-key-positions = <TRIGGER_POS>; \
        hold-trigger-on-release; \
    )


/**
 *  left-arrow->home and  right-arrow->end
 */
/** long-tap action on hold, short-tap action on all interrupts */
#define MT_CORE \
    flavor = "tap-preferred"; \
    tapping-term-ms = <MT_CORE_TAPPING_TERM_MS>; \
    quick-tap-ms = <MT_CORE_QUICK_TAP_MS>; \
    hold-trigger-key-positions = <0>;

&mt { MT_CORE };

/** modified home  used for  long tap left-arrow -> beginning of line*/
ZMK_HOLD_TAP(mt_home, bindings = <&masked_home>, <&kp>; MT_CORE)

/** modified end  used for  long tap right-arrow -> end of line*/
ZMK_HOLD_TAP(mt_end,   bindings = <&masked_end>, <&kp>; MT_CORE)

/** mask CTRL when holding left/right to avoid accidental jumps to beginning/end of document */
#define MASK_MODS(NAME, MODS, BINDING) \
    ZMK_MOD_MORPH(NAME, \
        bindings = <BINDING>, <BINDING>; \
        mods = <MODS>; \
    )
MASK_MODS(masked_home, (MOD_LCTL), &kp HOME)
MASK_MODS(masked_end,  (MOD_LCTL), &kp END)


/**
 * tap-preferred for media and volume
 */
ZMK_HOLD_TAP(tap_preferred,
    flavor = "tap-preferred";
    tapping-term-ms = <HRM_TAPPING_TERM_MS>;
    quick-tap-ms = <HRM_QUICK_TAP_MS>;
    bindings = <&kp>, <&kp>;
)


/**
 * hold-preferred for game
 */
ZMK_HOLD_TAP(hold_preferred,
    flavor = "hold-preferred";
    tapping-term-ms = <HRM_TAPPING_TERM_MS>;
    quick-tap-ms = <HRM_QUICK_TAP_MS>;
    bindings = <&kp>, <&kp>;
)


/**
 * home-row-mods left and right
 */
/** left-split HRMs */
MAKE_HRM(hml, &kp, &kp, KEYS_R THUMBS)

/** right-split HRMs */
MAKE_HRM(hmr, &kp, &kp, KEYS_L THUMBS)


/** tap: sticky left shift | double tap: capsword */
ZMK_MOD_MORPH(cs_shft,
    bindings = <&sk LSHFT>, <&caps_word>;
    mods = <(MOD_LSFT)>;
)


/**
 * tap: space | shift + tap: dot -> space -> sticky shift | hold/long-tap: activate layer
 */
ZMK_HOLD_TAP(dot_space,
    flavor = "balanced";
    tapping-term-ms = <TAPPING_TERM_MS>;
    quick-tap-ms = <QUICK_TAP_MS>;
    bindings = <&tog>, <&space_morph>;
)

/** tap: space | shift + tap: dot -> space -> sticky shift  */
SIMPLE_MORPH(space_morph, SFT, &kp SPACE, &dot_spc)

/** shift + tap: dot -> space -> sticky shift */
ZMK_MACRO(dot_spc,
    wait-ms = <0>;
    tap-ms = <TAP_MS>;
    bindings = <&kp DOT &kp SPACE &sk LSHFT>;
)


/**
 * hold: layer | tap: backspace | shift + tap: delete
 */
ZMK_HOLD_TAP(bspc_delete,
    flavor = "balanced";
    tapping-term-ms = <TAPPING_TERM_MS>;
    quick-tap-ms = <QUICK_TAP_MS>;
    bindings = <&tog>, <&bspc_del>;
)

/** tap: backspace | shift + tap: delete */
ZMK_MOD_MORPH(bspc_del,
    bindings = <&kp BSPC>, <&kp DEL>;
    mods = <(MOD_LSFT|MOD_RSFT)>;
    keep-mods = <MOD_RSFT>;
)


/**
 * tap: num-word | double-tap: sticky num-layer | hold: layer
 */
ZMK_HOLD_TAP(n_num_wrd,
    flavor = "balanced";
    tapping-term-ms = <TAPPING_TERM_MS>;
    quick-tap-ms = <QUICK_TAP_MS>;
    bindings = <&tog>, <&num_dance>;
)

/** tap: num-word | double-tap: sticky num-layer */
ZMK_TAP_DANCE(num_dance,
    tapping-term-ms = <TAP_DANCE_TAPPING_TERM_MS>;
    bindings = <&num_word>, <&sl NUMS>;  // reverse this for sticky-num on single tap
)


/**
 * tap: CTRL | double-tap: CTRL | triple-tap: ESC| long-tap: tab
 */
ZMK_HOLD_TAP(m_esc_,
    flavor = "balanced";
    tapping-term-ms = <TAPPING_TERM_MS>;
    quick-tap-ms = <QUICK_TAP_MS>;
    bindings = <&kp>, <&m_esc>;
)

/** tap: CTRL | double-tap: CTRL | triple-tap: ESC */
ZMK_TAP_DANCE(m_esc,
    tapping-term-ms = <TAP_DANCE_TAPPING_TERM_MS>;
    bindings = <&kp M>, <&kp ESC>;
)


/**
 * tap: copy | double-tap: cut | long_hold: paste
 */
ZMK_HOLD_TAP(g_h_,
    flavor = "balanced";
    tapping-term-ms = <TAPPING_TERM_MS>;
    quick-tap-ms = <QUICK_TAP_MS>;
    bindings = <&kp>, <&g_h>;
)

/** tap: G | double-tap: H */
ZMK_TAP_DANCE(g_h,
    tapping-term-ms = <TAP_DANCE_TAPPING_TERM_MS>;
    bindings = <&kp G>, <&kp H>;
)


/**
 * tap: 1 | double-tap: 2 | long_hold: 4
 */
ZMK_HOLD_TAP(n1_2_,
    flavor = "balanced";
    tapping-term-ms = <TAPPING_TERM_MS>;
    quick-tap-ms = <QUICK_TAP_MS>;
    bindings = <&kp>, <&n1_2>;
)

/** tap: 1 | double-tap: 2 */
ZMK_TAP_DANCE(n1_2,
    tapping-term-ms = <TAP_DANCE_TAPPING_TERM_MS>;
    bindings = <&kp N1>, <&kp N2>;
)


/**
 * tap: C | double-tap: 3
 */
ZMK_TAP_DANCE(c_3,
    tapping-term-ms = <TAP_DANCE_TAPPING_TERM_MS>;
    bindings = <&kp C>, <&kp N3>;
)


/**
 * tap: F | double-tap: Space
 */
ZMK_TAP_DANCE(f_space,
    tapping-term-ms = <TAP_DANCE_TAPPING_TERM_MS>;
    bindings = <&kp F>, <&kp SPACE>;
)


/**
 * tap: copy | double-tap: cut | long_hold: paste
 */
ZMK_HOLD_TAP(ccp,
    flavor = "balanced";
    tapping-term-ms = <TAPPING_TERM_MS>;
    quick-tap-ms = <QUICK_TAP_MS>;
    bindings = <&kp>, <&copy_cut>;
)

/** tap: copy | double-tap: cut */
ZMK_TAP_DANCE(copy_cut,
    tapping-term-ms = <TAP_DANCE_TAPPING_TERM_MS>;
    bindings = <&kp LC(INS)>, <&kp LC(X)>;
)


/** tap: capsword | double-tap: sys layer */
ZMK_TAP_DANCE(cwrd_sys,
    tapping-term-ms = <TAP_DANCE_TAPPING_TERM_MS>;
    bindings = <&caps_word>, <&tog SYS>;
)


/**
 * Alt+Tab swapper, requires PR #1366
 */
ZMK_TRI_STATE(alt_tab,
    bindings = <&kt LALT>, <&kp TAB>, <&kt LALT>;
    ignored-key-positions = <LT2>;
)


/**
 * Ctrl+Tab swapper, requires PR #1366
 */
ZMK_TRI_STATE(ctrl_tab,
    bindings = <&kt LCTRL>, <&kp TAB>, <&kt LCTRL>;
    ignored-key-positions = <LB2>;
)


/**
 * smart-mouse, requires PR #1366
 */
ZMK_TRI_STATE(mouse_l,
    bindings = <&tog MOUSE>, <&none>, <&tog MOUSE>;
    ignored-key-positions = <LT1 LT3 RT0 RT1 RT2 RT3 RT4 RM1 RM2 RM3 RB1 RB2 RB3 RH0 RH1>; //need figuring out
    ignored-layers = <MOUSE>;
)



/**
 * windows shut-down WIN + X + U + U
 */
ZMK_MACRO(win_shutdown,
    wait-ms = <WAIT_MS>;
    tap-ms = <TAP_MS>;
    bindings = <&kp LG(X) &kp U &kp U>;
)


/**
 * windows restart WIN + X + U + R
 */
ZMK_MACRO(win_restart,
    wait-ms = <WAIT_MS>;
    tap-ms = <TAP_MS>;
    bindings = <&kp LG(X) &kp U &kp R>;
)


/**
 * Layers Keymap
 */
 /** Activate SYS layer by holding MOUSE and FNG*/
//ZMK_CONDITIONAL_LAYER(MOUSE FNG, SYS)


/** Default QWERTY */
ZMK_LAYER_3(def,
    // ╭─────────────┬─────────────┬─────────────┬──────────────┬────────────────┬───────────────────────╮                                            ╭────────────────────┬──────────────────┬──────────────┬─────────────┬────────────────┬──────────╮
         XXXXX         XXXXX         XXXXX         XXXXX          XXXXX            XXXXX                                                                XXXXX                XXXXX              XXXXX          XXXXX         XXXXX            XXXXX
    // ├─────────────┼─────────────┼─────────────┼──────────────┼────────────────┼───────────────────────┤                                            ├────────────────────┼──────────────────┼──────────────┼─────────────┼────────────────┼──────────┤
         XXXXX         &kp Q         &kp W         &kp E          &kp R            &kp T                                                                &kp Y                &kp U              &kp I          &kp O         &kp P            XXXXX
    // ├─────────────┼─────────────┼─────────────┼──────────────┼────────────────┼───────────────────────┤                                            ├────────────────────┼──────────────────┼──────────────┼─────────────┼────────────────┼──────────┤
         XXXXX         &hml LGUI A   &hml LALT S   &hml LCTRL D   &hml LSHFT F     &hml ESC G                                                           &hmr TAB H           &hmr RSHFT J       &hmr RCTRL K   &hmr RALT L   &hmr RGUI SEMI   XXXXX
    // ├─────────────┼─────────────┼─────────────┼──────────────┼────────────────┼───────────────────────┼────────────────╮    ╭──────────────────────┼────────────────────┼──────────────────┼──────────────┼─────────────┼────────────────┼──────────┤
         XXXXX         &kp Z         &kp X         &kp C          &kp V            &hml K_CANCEL B         &kp C_MUTE            &kp C_MUTE             &kp N                &kp M              &kp COMMA      &kp DOT       &kp FSLH         XXXXX
    // ╰─────────────┴─────────────┼─────────────┼──────────────┼────────────────┼───────────────────────┼────────────────┤    ├──────────────────────┼────────────────────┼──────────────────┼──────────────┼─────────────┼────────────────┴──────────╯
                                     XXXXX         XXXXX          &cwrd_sys        &n_num_wrd NAV 0        &lt FNG RET           &dot_space MOUSE 0     &bspc_delete GAME 0  &ccp LS(INS) 0     XXXXX          XXXXX
    //                             ╰─────────────┴──────────────┴────────────────┴───────────────────────┴────────────────╯    ╰──────────────────────┴────────────────────┴──────────────────┴──────────────┴─────────────╯
    ,
    &inc_dec_kp C_VOL_UP C_VOL_DN &inc_dec_kp PG_UP PG_DN
)


/** Number and Symbols */
ZMK_LAYER_3(nums,
    // ╭─────────────┬──────────────┬──────────────┬───────────────┬───────────────┬─────────────╮                                ╭─────────────┬───────────────┬─────────────────┬──────────────┬──────────────┬─────────────╮
         _____         _____          _____          _____           _____           _____                                          _____         _____           _____             _____          _____          _____
    // ├─────────────┼──────────────┼──────────────┼───────────────┼───────────────┼─────────────┤                                ├─────────────┼───────────────┼─────────────────┼──────────────┼──────────────┼─────────────┤
         _____         &curr_euro     &kp MINUS      &kp LPAR        &kp FSLH        &kp GRAVE                                      _____         &kp BSLH        &kp RPAR          &kp EQUAL          _____          _____
    // ├─────────────┼──────────────┼──────────────┼───────────────┼───────────────┼─────────────┤                                ├─────────────┼───────────────┼─────────────────┼──────────────┼──────────────┼─────────────┤
         _____         &hml LGUI N4   &hml LALT N3   &hml LCTRL N2   &hml LSHFT N1   &hml ESC N0                                    &hmr TAB N5   &hmr RSHFT N6   &hmr RCTRL N7     &hmr RALT N8   &hmr RGUI N9   _____
    // ├─────────────┼──────────────┼──────────────┼───────────────┼───────────────┼─────────────┼─────────────╮    ╭─────────────┼─────────────┼───────────────┼─────────────────┼──────────────┼──────────────┼─────────────┤
         _____         _____          &kp COMMA      &kp LBKT        &kp SEMI        CANCEL        _____              _____         _____         &kp SQT         &kp RBKT          _____          _____          _____
    // ╰─────────────┴──────────────┼──────────────┼───────────────┼───────────────┼─────────────┼─────────────┤    ├─────────────┼─────────────┼───────────────┼─────────────────┼──────────────┼──────────────┴─────────────╯
                                      _____          _____           _____           _____         _____              _____         _____         _____           _____             _____
    //                              ╰──────────────┴───────────────┴───────────────┴─────────────┴─────────────╯    ╰─────────────┴─────────────┴───────────────┴─────────────────┴──────────────╯
    ,
    &inc_dec_kp C_VOL_UP C_VOL_DN &inc_dec_kp PG_UP PG_DN
)


/** Function Keys and German characters */
ZMK_LAYER_3(fng,
    // ╭──────────────┬──────────────┬──────────────┬──────────────┬───────────────┬─────────────╮                                ╭─────────────┬───────────────┬─────────────────┬───────────────┬──────────────┬─────────────╮
         _____          _____          _____          _____          _____           _____                                          _____         _____           _____             _____           _____          _____
    // ├──────────────┼──────────────┼──────────────┼──────────────┼───────────────┼─────────────┤                                ├─────────────┼───────────────┼─────────────────┼───────────────┼──────────────┼─────────────┤
         &kp F18        &kp F17        &kp F16        &kp F15        &kp F14         &kp F13                                        &kp F19       &kp F20         &kp F21           &kp F22         &kp F23        &kp F24
    // ├──────────────┼──────────────┼──────────────┼──────────────┼───────────────┼─────────────┤                                ├─────────────┼───────────────┼─────────────────┼───────────────┼──────────────┼─────────────┤
         &kp F6         &hml LGUI F5   &hml LALT F4   &hml LCTRL F3  &hml LSHFT F2   &hml ESC F1                                   &hmr TAB F7   &hmr RSHFT F8   &hmr RCTRL F9     &hmr RALT F10   &hmr RGUI F11   &kp F12
    // ├──────────────┼──────────────┼──────────────┼──────────────┼───────────────┼─────────────┼─────────────╮    ╭─────────────┼─────────────┼───────────────┼─────────────────┼───────────────┼──────────────┼─────────────┤
         _____          &de_ae         &de_eszett     _____          _____           CANCEL        _____              _____         _____         &de_ue          _____             &de_oe          _____          _____
    // ╰──────────────┴──────────────┼──────────────┼──────────────┼───────────────┼─────────────┼─────────────┤    ├─────────────┼─────────────┼───────────────┼─────────────────┼───────────────┼──────────────┴─────────────╯
                                      _____          _____           _____           _____         _____              _____         _____         _____           _____             _____
    //                              ╰──────────────┴───────────────┴───────────────┴─────────────┴─────────────╯    ╰─────────────┴─────────────┴───────────────┴─────────────────┴───────────────╯
    ,
    &inc_dec_kp C_VOL_UP C_VOL_DN &inc_dec_kp PG_UP PG_DN
)


/** Navigation */
ZMK_LAYER_3(nav,
    // ╭───────┬───────────┬────────────┬─────────────────┬─────────────┬────────────╮                                ╭─────────────┬───────────────┬─────────────────┬───────────────┬──────────────┬─────────────╮
         _____   _____       _____        _____             _____         _____                                         _____         _____           _____             _____           _____          _____
    // ├───────┼───────────┼────────────┼─────────────────┼─────────────┼────────────┤                                ├─────────────┼───────────────┼─────────────────┼───────────────┼──────────────┼─────────────┤
         _____   &kp LG(M)   &kp LC(F5)   &kp LS(TAB)       &alt_tab      &kp LG(D)                                     &kp PG_UP     NAV_BSPC        NAV_UP            NAV_DEL         &kp PSCRN      _____
    // ├───────┼───────────┼────────────┼─────────────────┼─────────────┼────────────┤                                ├─────────────┼───────────────┼─────────────────┼───────────────┼──────────────┼─────────────┤
         _____   &kp LGUI    &kp LALT     &kp LCTRL         &kp LSHFT     &kp ESC                                       &kp TAB       NAV_LEFT        NAV_DOWN          NAV_RIGHT       _____          _____
    // ├───────┼───────────┼────────────┼─────────────────┼─────────────┼────────────┼─────────────╮    ╭─────────────┼─────────────┼───────────────┼─────────────────┼───────────────┼──────────────┼─────────────┤
         _____   _____       _____        &kp LS(TAB)       &ctrl_tab     CANCEL       _____              _____         &kp PG_DN     &kp LC(Z)       &kp LC(Y)         &kp LC(FSLH)    &kp INS        _____
    // ╰───────┴───────────┼────────────┼─────────────────┼─────────────┼────────────┼─────────────┤    ├─────────────┼─────────────┼───────────────┼─────────────────┼───────────────┼──────────────┴─────────────╯
                             _____        _____             _____         _____        _____              _____         _____         _____           _____             _____
    //                     ╰────────────┴─────────────────┴─────────────┴────────────┴─────────────╯    ╰─────────────┴─────────────┴───────────────┴─────────────────┴───────────────╯
    ,
    &inc_dec_kp C_VOL_UP C_VOL_DN &inc_dec_kp PG_UP PG_DN
)


/** Mouse */
ZMK_LAYER_3(mouse,
    // ╭───────────────┬─────────────────┬────────────────┬────────────────┬────────────────┬────────────────╮                                ╭────────────────┬─────────────┬─────────────────┬─────────────┬─────────────┬─────────────╮
         XXXXX           XXXXX             XXXXX            XXXXX            XXXXX            XXXXX                                             XXXXX            XXXXX         XXXXX             XXXXX         XXXXX         XXXXX
    // ├───────────────┼─────────────────┼────────────────┼────────────────┼────────────────┼────────────────┤                                ├────────────────┼─────────────┼─────────────────┼─────────────┼─────────────┼─────────────┤
         XXXXX           XXXXX             XXXXX            M_SCROLL_U       M_BUTTON_L       M_BUTTON_M                                        XXXXX            M_BUTTON_R    M_CURSOR_U        XXXXX         XXXXX         XXXXX
    // ├───────────────┼─────────────────┼────────────────┼────────────────┼────────────────┼────────────────┤                                ├────────────────┼─────────────┼─────────────────┼─────────────┼─────────────┼─────────────┤
         XXXXX           &kp LGUI          &kp LALT         &kp LCTRL        &kp LSHFT        &kp ESC                                           &kp TAB         M_CURSOR_L    M_CURSOR_D        M_CURSOR_R    XXXXX         XXXXX
    // ├───────────────┼─────────────────┼────────────────┼────────────────┼────────────────┼────────────────┼─────────────╮    ╭─────────────┼────────────────┼─────────────┼─────────────────┼─────────────┼─────────────┼─────────────┤
         XXXXX           XXXXX             M_SCROLL_L       M_SCROLL_D       M_SCROLL_R        CANCEL           _____              _____        XXXXX            M_BUTTON_4    M_BUTTON_5        &kp LC(FSLH)  XXXXX         XXXXX
    // ╰───────────────┴─────────────────┼────────────────┼────────────────┼────────────────┼────────────────┼─────────────┤    ├─────────────┼────────────────┼─────────────┼─────────────────┼─────────────┼─────────────┴─────────────╯
                                           XXXXX            XXXXX            _____            _____            _____              _____         _____            _____         XXXXX             XXXXX
    //                                   ╰────────────────┴────────────────┴────────────────┴────────────────┴─────────────╯    ╰─────────────┴────────────────┴─────────────┴─────────────────┴─────────────╯
    ,
    &inc_dec_kp C_VOL_UP C_VOL_DN &inc_dec_kp PG_UP PG_DN
)


/** Keyboard and Media Functions */
//ZMK_LAYER_3(sys,
//    // ╭───────────────┬─────────────────┬────────────────┬───────────────────┬────────────────┬────────────────╮                                ╭────────────────┬─────────────┬─────────────────┬─────────────┬─────────────┬─────────────╮
//         XXXXX           XXXXX             XXXXX            XXXXX               XXXXX            XXXXX                                             XXXXX            XXXXX         XXXXX             XXXXX         XXXXX         XXXXX
//    // ├───────────────┼─────────────────┼────────────────┼───────────────────┼────────────────┼────────────────┤                                ├────────────────┼─────────────┼─────────────────┼─────────────┼─────────────┼─────────────┤
//         &bootloader     PREV_RW            PP_S            NXT_FF              REPEAT           SHUFFLE                                           XXXXX            SP_INC        SP_DEC            SAT_INC       SAT_DEC       &bootloader
//    // ├───────────────┼─────────────────┼────────────────┼───────────────────┼────────────────┼────────────────┤                                ├────────────────┼─────────────┼─────────────────┼─────────────┼─────────────┼─────────────┤
//         &bt BT_CLR_ALL  &bt BT_CLR        &bt BT_SEL 3     &bt BT_SEL 2        &bt BT_SEL 1     &bt BT_SEL 0                                      LED_TOG          BRI_INC       BRI_DEC           HUE_INC       HUE_DEC       XXXXX
//    // ├───────────────┼─────────────────┼────────────────┼───────────────────┼────────────────┼────────────────┼─────────────╮    ╭─────────────┼────────────────┼─────────────┼─────────────────┼─────────────┼─────────────┼─────────────┤
//         &sys_reset      XXXXX             VOL_DN_MU        &ext_power EP_TOG   VOL_U            CANCEL           _____              _____         EFF_FW           EFF_BCK       PURPLE            XXXXX         XXXXX         &sys_reset
//    // ╰───────────────┴─────────────────┼────────────────┼───────────────────┼────────────────┼────────────────┼─────────────┤    ├─────────────┼────────────────┼─────────────┼─────────────────┼─────────────┼─────────────┴─────────────╯
//                                           XXXXX            XXXXX               _____            _____            _____              _____         _____            _____         XXXXX             XXXXX
//    //                                   ╰────────────────┴───────────────────┴────────────────┴────────────────┴─────────────╯    ╰─────────────┴────────────────┴─────────────┴─────────────────┴─────────────╯
//    ,
//    &inc_dec_kp C_VOL_UP C_VOL_DN &inc_dec_kp PG_UP PG_DN
//)


/** Keyboard and Media Functions */
ZMK_LAYER_3(sys,
    // ╭───────────────┬─────────────────┬────────────────┬───────────────────┬────────────────┬────────────────╮                                ╭────────────────┬─────────────┬─────────────────┬──────────────┬───────────────┬─────────────╮
         XXXXX           XXXXX             XXXXX            XXXXX               XXXXX            XXXXX                                             XXXXX            XXXXX         XXXXX             XXXXX          XXXXX           XXXXX
    // ├───────────────┼─────────────────┼────────────────┼───────────────────┼────────────────┼────────────────┤                                ├────────────────┼─────────────┼─────────────────┼──────────────┼───────────────┼─────────────┤
         &bootloader     PREV_RW            PP_S            NXT_FF              REPEAT           SHUFFLE                                           XXXXX            XXXXX         XXXXX             &win_restart   &win_shutdown   &bootloader
    // ├───────────────┼─────────────────┼────────────────┼───────────────────┼────────────────┼────────────────┤                                ├────────────────┼─────────────┼─────────────────┼──────────────┼───────────────┼─────────────┤
         &bt BT_CLR_ALL  &bt BT_CLR        &bt BT_SEL 3     &bt BT_SEL 2        &bt BT_SEL 1     &bt BT_SEL 0                                      XXXXX            XXXXX         XXXXX             XXXXX          XXXXX           XXXXX
    // ├───────────────┼─────────────────┼────────────────┼───────────────────┼────────────────┼────────────────┼─────────────╮    ╭─────────────┼────────────────┼─────────────┼─────────────────┼──────────────┼───────────────┼─────────────┤
         &sys_reset      XXXXX             VOL_MU           VOL_D               VOL_U            CANCEL           _____              _____         XXXXX            XXXXX         XXXXX             XXXXX          XXXXX           &sys_reset
    // ╰───────────────┴─────────────────┼────────────────┼───────────────────┼────────────────┼────────────────┼─────────────┤    ├─────────────┼────────────────┼─────────────┼─────────────────┼──────────────┼───────────────┴─────────────╯
                                           XXXXX            XXXXX               _____            _____            _____              _____         _____            _____         XXXXX             XXXXX
    //                                   ╰────────────────┴───────────────────┴────────────────┴────────────────┴─────────────╯    ╰─────────────┴────────────────┴─────────────┴─────────────────┴──────────────╯
    ,
    &inc_dec_kp C_VOL_UP C_VOL_DN &inc_dec_kp PG_UP PG_DN
)


/** Game  */
ZMK_LAYER_3(game,
    // ╭─────────────┬─────────────┬─────────────┬──────────────┬────────────────┬───────────────────────╮                                           ╭────────────────────┬──────────────────┬──────────────┬─────────────┬────────────────┬──────────╮
         XXXXX         XXXXX         XXXXX         XXXXX          XXXXX            XXXXX                                                               XXXXX                XXXXX              XXXXX          XXXXX         XXXXX            XXXXX
    // ├─────────────┼─────────────┼─────────────┼──────────────┼────────────────┼───────────────────────┤                                           ├────────────────────┼──────────────────┼──────────────┼─────────────┼────────────────┼──────────┤
         XXXXX         XXXXX         &kp Q         &kp W          &kp E            R_T                                                                 &kp Y                &kp U              &kp I          &kp O         &kp P            XXXXX
    // ├─────────────┼─────────────┼─────────────┼──────────────┼────────────────┼───────────────────────┤                                           ├────────────────────┼──────────────────┼──────────────┼─────────────┼────────────────┼──────────┤
         &kp TAB       &kp Z         &kp A         &kp S          &kp D            &f_space                                                            &hmr TAB H           &hmr RSHFT J       &hmr RCTRL K   &hmr RALT L   &hmr RGUI SEMI   XXXXX
    // ├─────────────┼─────────────┼─────────────┼──────────────┼────────────────┼───────────────────────┼────────────────╮    ╭─────────────────────┼────────────────────┼──────────────────┼──────────────┼─────────────┼────────────────┼──────────┤
         XXXXX         XXXXX         Y_V           &kp X          &c_3             G_H_B                     &kp C_MUTE            &kp C_MUTE            &hmr K_CANCEL N      &kp M              &kp COMMA      &kp DOT       &kp FSLH         XXXXX
    // ╰─────────────┴─────────────┼─────────────┼──────────────┼────────────────┼───────────────────────┼────────────────┤    ├─────────────────────┼────────────────────┼──────────────────┼──────────────┼─────────────┼────────────────┴──────────╯
                                     XXXXX         XXXXX          N1_2_4           &kp LSHFT               M_ESC_CTRL            _____                 _____                _____              XXXXX          XXXXX
    //                             ╰─────────────┴──────────────┴────────────────┴───────────────────────┴────────────────╯    ╰─────────────────────┴────────────────────┴──────────────────┴──────────────┴─────────────╯
    ,
    &inc_dec_kp C_VOL_UP C_VOL_DN &inc_dec_kp PG_UP PG_DN
)