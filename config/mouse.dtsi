#define ZMK_MOUSE_DEFAULT_MOVE_VAL 2500  // 600
#define ZMK_MOUSE_DEFAULT_SCRL_VAL 20    // 10

#include <dt-bindings/zmk/mouse.h>
#include <behaviors/mouse_keys.dtsi>

&mmv {
    acceleration-exponent = <1>;                            // 1
    time-to-max-speed-ms = <ZMK_MOUSE_DEFAULT_MOVE_VAL>;    // 500
    delay-ms = <0>;                                         // 0
};

&msc {
    acceleration-exponent = <1>;                            // 0
    time-to-max-speed-ms = <ZMK_MOUSE_DEFAULT_SCRL_VAL>;    // 40
    delay-ms = <0>;                                         // 10
};

#define M_CURSOR_U &mmv MOVE_UP
#define M_CURSOR_D &mmv MOVE_DOWN
#define M_CURSOR_L &mmv MOVE_LEFT
#define M_CURSOR_R &mmv MOVE_RIGHT
#define M_SCROLL_U &msc SCRL_UP
#define M_SCROLL_D &msc SCRL_DOWN
#define M_SCROLL_L &msc SCRL_LEFT
#define M_SCROLL_R &msc SCRL_RIGHT
#define M_BUTTON_L &mkp LCLK
#define M_BUTTON_R &mkp RCLK
#define M_BUTTON_M &mkp MCLK
#define M_BUTTON_4 &mkp MB4
#define M_BUTTON_5 &mkp MB5